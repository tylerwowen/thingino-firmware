## configs/modules/t10_ov9732_rtl8188eus_defconfig
```kconfig
# NAME: T10, OV9732, RTL8188EUS
# FRAG: soc toolchain ccache brand rootfs kernel system target uboot
BR2_PACKAGE_WIFI=y
BR2_PACKAGE_WIFI_RTL8188EUS=y
BR2_SENSOR_OV9732=y
BR2_SOC_INGENIC_T10A=y
```

## configs/modules/t20l_gc2023_rtl8189ftv_defconfig
```kconfig
# NAME: T20L, gc2023, RTL8189FTV
# FRAG: soc toolchain ccache brand rootfs kernel system target uboot
BR2_PACKAGE_WIFI=y
BR2_PACKAGE_WIFI_RTL8189FS=y
BR2_SENSOR_GC2023=y
BR2_SOC_INGENIC_T20L=y
```
